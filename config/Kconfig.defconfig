## config/Kconfig.defconfig
```kconfig
if SHIELD_LILY58_LEFT

config ZMK_KEYBOARD_NAME
	default "Lyly58"

config ZMK_SPLIT_BLE_ROLE_CENTRAL
	default y

endif

if SHIELD_LILY58_LEFT || SHIELD_LILY58_RIGHT

config ZMK_SPLIT
	default y
endif
```

## config/boards/shields/lily58/Kconfig.shield
```kconfig
# Copyright (c) 2020 
# SPDX-License-Identifier: MIT 2

config SHIELD_LILY58_LEFT
	def_bool $(shields_list_contains,lily58_left)

config SHIELD_LILY58_RIGHT
	def_bool $(shields_list_contains,lily58_right)
```

## config/west.yml
```yaml
manifest:
# test
  defaults:
    revision: v0.3
  remotes:
    - name: zmkfirmware
      url-base: https://github.com/zmkfirmware

    - name: gpeye
      url-base: https://github.com/GPeye

      #- name: mctechnology17
    #  url-base: https://github.com/mctechnology17
  projects:
    - name: zmk
      remote: zmkfirmware
      import: app/west.yml

    - name: hammerbeam-slideshow
      remote: gpeye
      revision: main

      # - name: zmk-nice-oled
   #   remote: mctechnology17
   #   revision: main
  self:
    path: config
```
